## config/west.yml
```yaml
manifest:
  remotes:
    - name: zmkfirmware
      url-base: https://github.com/zmkfirmware
  projects:
    - name: zmk
      remote: zmkfirmware
      revision: v0.3   # pin to a stable ZMK release (main is a moving target; see zmk.dev/blog/2025/06/20/pinned-zmk)
      import: app/west.yml
  self:
    path: config
```
